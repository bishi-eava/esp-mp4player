## sdkconfig.defaults.atoms3r
```kconfig
# ESP32-S3 Movie Player sdkconfig defaults (Atom S3R)
# board = m5stack-atoms3

# --- Target ---
CONFIG_IDF_TARGET="esp32s3"

# --- PSRAM (Octal SPI — ESP32-S3-PICO-1-N8R8 internal PSRAM requires Octal mode) ---
CONFIG_SPIRAM=y
CONFIG_SPIRAM_MODE_OCT=y
CONFIG_SPIRAM_TYPE_ESPPSRAM64=y
CONFIG_SPIRAM_SPEED_40M=y
CONFIG_SPIRAM_BOOT_INIT=y
CONFIG_SPIRAM_USE_MALLOC=y
CONFIG_SPIRAM_USE_CAPS_ALLOC=y
CONFIG_SPIRAM_MALLOC_RESERVE_INTERNAL=16384

# --- Flash (8MB, DIO to match board default) ---
CONFIG_ESPTOOLPY_FLASHSIZE_8MB=y
CONFIG_ESPTOOLPY_FLASHMODE_DIO=y
CONFIG_ESPTOOLPY_FLASHFREQ_80M=y

# --- CPU ---
CONFIG_ESP_DEFAULT_CPU_FREQ_MHZ_240=y

# --- Main task stack (H.264 decoder needs more stack) ---
CONFIG_ESP_MAIN_TASK_STACK_SIZE=16384

# --- Watchdog ---
CONFIG_ESP_TASK_WDT_TIMEOUT_S=10

# --- SPI DMA ---
CONFIG_SPI_MASTER_ISR_IN_IRAM=y

# --- Log level ---
CONFIG_LOG_DEFAULT_LEVEL_INFO=y

# --- FreeRTOS runtime stats (CPU load monitoring) ---
CONFIG_FREERTOS_USE_TRACE_FACILITY=y
CONFIG_FREERTOS_GENERATE_RUN_TIME_STATS=y
CONFIG_FREERTOS_RUN_TIME_STATS_USING_ESP_TIMER=y
CONFIG_FREERTOS_VTASKLIST_INCLUDE_COREID=y
```

## sdkconfig.defaults.atoms3r_spk
```kconfig
# ESP32-S3 Movie Player sdkconfig defaults (Atom S3R + SPK Base)
# board = m5stack-atoms3

# --- Target ---
CONFIG_IDF_TARGET="esp32s3"

# --- PSRAM (Octal SPI — ESP32-S3-PICO-1-N8R8 internal PSRAM requires Octal mode) ---
CONFIG_SPIRAM=y
CONFIG_SPIRAM_MODE_OCT=y
CONFIG_SPIRAM_TYPE_ESPPSRAM64=y
CONFIG_SPIRAM_SPEED_40M=y
CONFIG_SPIRAM_BOOT_INIT=y
CONFIG_SPIRAM_USE_MALLOC=y
CONFIG_SPIRAM_MALLOC_ALWAYSINTERNAL=4096
CONFIG_SPIRAM_MALLOC_RESERVE_INTERNAL=32768

# --- Flash (8MB, DIO to match board default) ---
CONFIG_ESPTOOLPY_FLASHSIZE_8MB=y
CONFIG_ESPTOOLPY_FLASHMODE_DIO=y
CONFIG_ESPTOOLPY_FLASHFREQ_80M=y

# --- CPU ---
CONFIG_ESP_DEFAULT_CPU_FREQ_MHZ_240=y

# --- FreeRTOS tick rate (1ms tick for precise PTS timing) ---
CONFIG_FREERTOS_HZ=1000

# --- Main task stack (H.264 decoder needs more stack) ---
CONFIG_ESP_MAIN_TASK_STACK_SIZE=16384

# --- Watchdog ---
CONFIG_ESP_TASK_WDT_TIMEOUT_S=10

# --- SPI DMA ---
CONFIG_SPI_MASTER_ISR_IN_IRAM=y

# --- WiFi memory optimization ---
CONFIG_ESP_WIFI_IRAM_OPT=n
CONFIG_ESP_WIFI_RX_IRAM_OPT=n
CONFIG_ESP_WIFI_STATIC_RX_BUFFER_NUM=4
CONFIG_ESP_WIFI_DYNAMIC_RX_BUFFER_NUM=8
CONFIG_ESP_WIFI_DYNAMIC_TX_BUFFER_NUM=8
CONFIG_LWIP_TCP_SND_BUF_DEFAULT=5744
CONFIG_LWIP_TCP_WND_DEFAULT=5744

# --- FAT Long File Name (required for file server upload/management) ---
CONFIG_FATFS_LFN_HEAP=y

# --- Log level ---
CONFIG_LOG_DEFAULT_LEVEL_INFO=y
```

## sdkconfig.defaults.spotpear
```kconfig
# ESP32-S3 Movie Player sdkconfig defaults

# --- Target ---
CONFIG_IDF_TARGET="esp32s3"

# --- PSRAM ---
CONFIG_SPIRAM=y
CONFIG_SPIRAM_MODE_OCT=y
CONFIG_SPIRAM_SPEED_80M=y
CONFIG_SPIRAM_BOOT_INIT=y
CONFIG_SPIRAM_USE_MALLOC=y
CONFIG_SPIRAM_MALLOC_ALWAYSINTERNAL=4096
CONFIG_SPIRAM_MALLOC_RESERVE_INTERNAL=32768

# --- Flash (16MB actual) ---
CONFIG_ESPTOOLPY_FLASHSIZE_16MB=y
CONFIG_ESPTOOLPY_FLASHMODE_QIO=y
CONFIG_ESPTOOLPY_FLASHFREQ_80M=y

# --- CPU ---
CONFIG_ESP_DEFAULT_CPU_FREQ_MHZ_240=y

# --- FreeRTOS ---
CONFIG_FREERTOS_HZ=1000

# --- Main task stack (H.264 decoder needs more stack) ---
CONFIG_ESP_MAIN_TASK_STACK_SIZE=16384

# --- Watchdog ---
CONFIG_ESP_TASK_WDT_TIMEOUT_S=10

# --- SPI DMA ---
CONFIG_SPI_MASTER_ISR_IN_IRAM=y

# --- Compiler optimization for performance ---
CONFIG_COMPILER_OPTIMIZATION_PERF=y

# --- Log level ---
CONFIG_LOG_DEFAULT_LEVEL_INFO=y
```
